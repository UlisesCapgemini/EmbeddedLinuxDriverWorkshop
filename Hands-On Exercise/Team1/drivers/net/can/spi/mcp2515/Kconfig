## Hands-On Exercise/Team1/drivers/net/can/spi/mcp2515/Kconfig
```kconfig
# Kconfig for mcp2515 driver
config MCP2515
	tristate "Microchip MCP2515 CAN controller"
	depends on SPI && CAN
	help
	  This driver supports the Microchip MCP2515 CAN controller.
```
